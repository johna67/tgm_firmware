## prj.conf
```kconfig
# Bluetooth Configuration
CONFIG_BT=y
CONFIG_BT_PERIPHERAL=y
CONFIG_BT_DEVICE_NAME="TGM"
CONFIG_BT_MAX_CONN=1

# Battery Optimization - Reduce BLE power
CONFIG_BT_CTLR_TX_PWR_MINUS_20=y
CONFIG_BT_CONN_INTERVAL_MIN=20
CONFIG_BT_CONN_INTERVAL_MAX=40

# Logging - Minimal for battery
CONFIG_LOG=y
CONFIG_LOG_MODE_MINIMAL=y
CONFIG_RTT_CONSOLE=y
CONFIG_USE_SEGGER_RTT=y
CONFIG_CONSOLE=n
CONFIG_UART_CONSOLE=n

# Application
CONFIG_APP_LOG_LEVEL=3

# PPG Configuration - Optimized for Masseter
CONFIG_PPG_SAMPLE_RATE=25
CONFIG_PPG_SAMPLES_PER_FRAME=20
CONFIG_PPG_LOG_LEVEL=3

# Accelerometer Configuration
CONFIG_ACC_SAMPLE_RATE=25
CONFIG_ACC_SAMPLES_PER_FRAME=25
CONFIG_ACC_LOG_LEVEL=3

# Temperature Configuration
CONFIG_TEMPERATURE_MEASUREMENT_INTERVAL=10

# Battery Configuration
CONFIG_BATTERY_MEASUREMENT_INTERVAL=60

# Power Management
CONFIG_PM=y
CONFIG_PM_DEVICE=y
CONFIG_PM_POLICY_APP=y
```

## src/main.c
```c
/*
 * Copyright (c) 2024 WeeGee bv
 */

#include <zephyr/kernel.h>
#include <zephyr/device.h>
#include <zephyr/drivers/gpio.h>
#include <zephyr/drivers/sensor.h>

#include <app_version.h>

#include "ble.h"
#include "ppg.h"
#include "acc.h"
#include "battery.h"
#include "tgm_service.h"

#include <zephyr/logging/log.h>
LOG_MODULE_REGISTER(main, CONFIG_APP_LOG_LEVEL);

#define GPIO_NODE DT_NODELABEL(gpio0)
#define SENS_ENABLE_PIN 8

// Device temperature thresholds, with hysteresis
#define DEVICE_WORN_TEMPERATURE_THRESHOLD 2550
#define DEVICE_NOT_WORN_TEMPERATURE_THRESHOLD 2450

enum device_state_t
{
	DEVICE_STATE_NOT_WORN_NOT_CHARGING,
	DEVICE_STATE_NOT_WORN_CHARGING,
	DEVICE_STATE_WORN,
	DEVICE_STATE_INIT,
};

static volatile bool charging = false;
static volatile bool worn = false;

static const struct device *gpio = DEVICE_DT_GET(GPIO_NODE);
static const struct device *temp_sensor = DEVICE_DT_GET(DT_NODELABEL(temp));
static const struct gpio_dt_spec chrsts_gpio = GPIO_DT_SPEC_GET_BY_IDX(DT_PATH(zephyr_user), chrsts_gpios, 0);

static struct gpio_callback chrsts_cb;

static struct k_work_delayable temperature_work;
static struct charging_work_t
{
	struct k_work work;
	bool charging_new_state;
} charging_work;

static enum device_state_t device_state = DEVICE_STATE_INIT;

static int update_state(bool charging_new_state, bool worn_new_state)
{
	int err;

	if ((device_state == DEVICE_STATE_INIT) && !charging && !worn)
	{
		// Initialize the green LED to a low value to indicate that the device is still working
		err = ppg_set_led_pa(PPG_LED_GREEN, 5);
		if (err)
		{
			LOG_ERR("Failed to set PPG LED PA for LED %d", PPG_LED_GREEN);
			return err;
		}

		device_state = DEVICE_STATE_NOT_WORN_NOT_CHARGING;
	}

	if (charging_new_state == charging && worn_new_state == worn)
	{
		// No change, do nothing
		return 0;
	}

	if (charging_new_state != charging)
	{
		// Charging state changed
		charging = charging_new_state;
		// Check if charging started or stopped
		if (charging)
		{
			// Enable the green LED
			err = ppg_set_led_pa(PPG_LED_GREEN, 32);
			if (err)
			{
				LOG_ERR("Failed to set PPG LED PA for LED %d", PPG_LED_GREEN);
				return err;
			}

			// Charging started
			device_state = DEVICE_STATE_NOT_WORN_CHARGING;
		}
		else
		{
			// Disable the green LED
			err = ppg_set_led_pa(PPG_LED_GREEN, 0);
			if (err)
			{
				LOG_ERR("Failed to disable PPG LED PA for LED %d", PPG_LED_GREEN);
				return err;
			}

			if (worn)
			{
				// Charging stopped while worn	
				device_state = DEVICE_STATE_WORN;
			}
			else
			{
				// Charging stopped while not worn
				device_state = DEVICE_STATE_NOT_WORN_NOT_CHARGING;
			}
		}
	}

	if (worn_new_state != worn)
	{
		// Worn state changed
		worn = worn_new_state;
		// Check if worn started or stopped
		if (worn)
		{
			// Enable the Red and IR LEDs
			err = ppg_set_led_pa(PPG_LED_RED, 32);
			if (err)
			{
				LOG_ERR("Failed to set PPG LED PA for LED %d", PPG_LED_RED);
				return err;
			}

			err = ppg_set_led_pa(PPG_LED_IR, 128);
			if (err)
			{
				LOG_ERR("Failed to set PPG LED PA for LED %d", PPG_LED_IR);
				return err;
			}

			// Worn started
			device_state = DEVICE_STATE_WORN;
		}
		else
		{
			// Disable the Red and IR LEDs
			err = ppg_set_led_pa(PPG_LED_RED, 0);
			if (err)
			{
				LOG_ERR("Failed to disable PPG LED PA for LED %d", PPG_LED_RED);
				return err;
			}

			err = ppg_set_led_pa(PPG_LED_IR, 0);
			if (err)
			{
				LOG_ERR("Failed to disable PPG LED PA for LED %d", PPG_LED_IR);
				return err;
			}
			
			if (charging)
			{
				// Worn stopped while charging
				device_state = DEVICE_STATE_NOT_WORN_CHARGING;
			}
			else
			{
				// Worn stopped while not charging
				device_state = DEVICE_STATE_NOT_WORN_NOT_CHARGING;

				// Set the green LED to a low value to indicate that the device is still working
				err = ppg_set_led_pa(PPG_LED_GREEN, 5);
				if (err)
				{
					LOG_ERR("Failed to disable PPG LED PA for LED %d", PPG_LED_GREEN);
					return err;
				}
			}
		}
	}

	LOG_INF("Device state changed to %d", device_state);

	return 0;
}

static void charging_work_handler(struct k_work *work)
{
	struct charging_work_t *charging_work = CONTAINER_OF(work, struct charging_work_t, work);

	update_state(charging_work->charging_new_state, worn);
}

static void temperature_work_handler(struct k_work *work)
{
	int err;
	struct sensor_value temp_value;
	int16_t centitemp; // Temperature in centi-degrees Celsius

	err = sensor_sample_fetch(temp_sensor);
	if (err)
	{
		LOG_ERR("Failed to fetch temperature sample with error %d", err);
		k_work_reschedule(&temperature_work, K_SECONDS(CONFIG_TEMPERATURE_MEASUREMENT_INTERVAL));
		return;
	}

	err = sensor_channel_get(temp_sensor, SENSOR_CHAN_DIE_TEMP, &temp_value);
	if (err)
	{
		LOG_ERR("Failed to get temperature value with error %d", err);
		k_work_reschedule(&temperature_work, K_SECONDS(CONFIG_TEMPERATURE_MEASUREMENT_INTERVAL));
		return;
	}

	centitemp = temp_value.val1 * 100 + temp_value.val2 / 10000;
	LOG_INF("Temperature: %d.%02d C", centitemp / 100, centitemp % 100);

	// Check if the device is worn (temperature > 30C)
	if (centitemp > DEVICE_WORN_TEMPERATURE_THRESHOLD)
	{
		update_state(charging, true);
	}
	else if (centitemp < DEVICE_NOT_WORN_TEMPERATURE_THRESHOLD)
	{
		update_state(charging, false);
	}

	tgm_service_send_temp_notify(centitemp);

	k_work_reschedule(&temperature_work, K_SECONDS(CONFIG_TEMPERATURE_MEASUREMENT_INTERVAL));
}

int32_t battery_voltage_read(void)
{
	return battery_get_last_measurement();
}

static void chrsts_callback(const struct device *dev, struct gpio_callback *cb, uint32_t pins)
{
	int err;
	uint8_t pin_state;
	pin_state = gpio_pin_get_dt(&chrsts_gpio);

	if (pin_state == 0)
	{
		LOG_INF("Chrsts pin is not active, device is not charging");

		charging_work.charging_new_state = false;
		k_work_submit(&charging_work.work);

		// Toggle the interrupt to notify when the charging state changes to active
		err = gpio_pin_interrupt_configure(gpio, chrsts_gpio.pin, GPIO_INT_LEVEL_ACTIVE);
		if (err)
		{
			LOG_ERR("Failed to configure chrsts pin interrupt");
		}
	}
	else
	{
		LOG_INF("Chrsts pin is active, device is charging");

		charging_work.charging_new_state = true;
		k_work_submit(&charging_work.work);

		// Toggle the interrupt to notify when the charging state changes to inactive
		err = gpio_pin_interrupt_configure(gpio, chrsts_gpio.pin, GPIO_INT_LEVEL_INACTIVE);
		if (err)
		{
			LOG_ERR("Failed to configure chrsts pin interrupt");
		}
	}
}

struct tgm_service_cb tgm_service_callbacks = {
	.bat_cb = battery_voltage_read,
};

int main(void)
{
	int err;

	printk("TGM Application %s\n", APP_VERSION_STRING);

	/* CRITICAL: Battery power latch MUST be first - before ANY returns */
	gpio_pin_configure(DEVICE_DT_GET(DT_NODELABEL(gpio0)), 10, GPIO_OUTPUT);
	gpio_pin_set(DEVICE_DT_GET(DT_NODELABEL(gpio0)), 10, 1);
	printk("*** BATTERY POWER ENABLED ON P0.10 ***\n");

	// Initialize the gpio port
	if (!device_is_ready(gpio))
	{
		LOG_ERR("GPIO is not ready");
		return -1;
	}

	// Initialize the sens_enable pin as output
	err = gpio_pin_configure(gpio, SENS_ENABLE_PIN, GPIO_OUTPUT_HIGH);

	err = ble_init();
	if (err)
	{
		LOG_ERR("ble_init() returned %d", err);
		return err;
	}

	tgm_service_init(&tgm_service_callbacks);

	// Initialize the temperature monitoring
	k_work_init_delayable(&temperature_work, temperature_work_handler);

	ble_adv_start();

	err = battery_init(NULL);
	if (err)
	{
		LOG_ERR("battery_init() returned %d", err);
	}

	// Start the battery measurement before any of the sensors are started
	err = battery_start_measurement();
	if (err)
	{
		LOG_ERR("battery_start_measurement() returned %d", err);
	}

	// Enable the power for the sensors
	err = gpio_pin_set(gpio, SENS_ENABLE_PIN, 1);
	if (err)
	{
		LOG_ERR("Failed to enable sensor power");
		return err;
	}

	// Wait for the sensor to power up
	k_sleep(K_MSEC(100));

	err = ppg_init();
	if (err)
	{
		LOG_ERR("ppg_init() returned %d", err);
	}

	err = acc_init();
	if (err)
	{
		LOG_ERR("acc_init() returned %d", err);
	}

	// Initialize the chrsts pin as input
	err = gpio_pin_configure_dt(&chrsts_gpio, GPIO_INPUT);
	if (err)
	{
		LOG_ERR("Failed to configure chrsts pin");
		return err;
	}

	// Initialize the callback for the chrsts pin
	gpio_init_callback(&chrsts_cb, chrsts_callback, BIT(chrsts_gpio.pin));
	err = gpio_add_callback(gpio, &chrsts_cb);
	if (err)
	{
		LOG_ERR("Failed to add callback to chrsts pin");
		return err;
	}

	k_work_init(&charging_work.work, charging_work_handler);

	// Track the charging state
	err = gpio_pin_interrupt_configure(gpio, chrsts_gpio.pin, GPIO_INT_LEVEL_ACTIVE);
	if (err)
	{
		LOG_ERR("Failed to configure chrsts pin interrupt");
		return err;
	}

	// Start the sensors
	err = ppg_start();
	if (err)
	{
		LOG_ERR("Failed to start the PPG sensor with error %d", err);
	}

	err = acc_start();
	if (err)
	{
		LOG_ERR("Failed to start the accelerometer sensor with error %d", err);
	}

	// Start the temperature monitoring
	k_work_reschedule(&temperature_work, K_NO_WAIT);

	return 0;
}
```

## src/ppg.c
```c
/*
 * Copyright (c) 2024 WeeGee bv
 */

#include <zephyr/devicetree.h>
#include <zephyr/drivers/gpio.h>
#include <zephyr/drivers/i2c.h>

#include "tgm_service.h"
#include "ppg.h"

#include <zephyr/logging/log.h>
LOG_MODULE_REGISTER(ppg, CONFIG_APP_LOG_LEVEL);

static struct gpio_callback ppg_int_cb;
static struct k_work read_ppg_data_work;

struct ppg_reg_work_t
{
    struct k_work reg_work;
    uint8_t reg;
    uint8_t data;
    bool read;
};

static void ppg_reg_work_handler(struct k_work *work);

static struct ppg_reg_work_t ppg_reg_work;

#if CONFIG_MAXM86161
#include <app/drivers/maxm86161.h>

#define MAXM86161_NODE DT_NODELABEL(maxm86161)
static struct gpio_dt_spec ppg_int = GPIO_DT_SPEC_GET(MAXM86161_NODE, int_gpios);

static struct i2c_dt_spec i2c = I2C_DT_SPEC_GET(MAXM86161_NODE);
#else
// Give a build error
#error "No valid PPG sensor driver enabled"
#endif

/**
 * @brief Callback function for the PPG sensor interrupt
 *
 * @param dev Pointer to the gpio port that triggered the callback
 * @param cb Pointer to the callback data that was used to set up the callback
 * @param pins Bitmask of pins that triggered the callback
 * @return int
 */
static void ppg_int_handler(const struct device *dev, struct gpio_callback *cb, uint32_t pins)
{
    if (pins & BIT(ppg_int.pin))
    {
        // Read the PPG data outside of the ISR
        k_work_submit(&read_ppg_data_work);
    }

    return;
}

static void ppg_read_data(struct k_work *work)
{
    struct ppg_sample ppg_data[CONFIG_PPG_SAMPLES_PER_FRAME];
    uint8_t sample_count;

    // Get the PPG data
    int err = ppg_sensor_get_data(&i2c, ppg_data, &sample_count);
    if (err)
    {
        LOG_ERR("Failed to read PPG data");
        return;
    }

    // Notify the client of the PPG data
    err = tgm_service_send_ppg_notify(ppg_data, sample_count);
    if (err)
    {
        LOG_DBG("Failed to send PPG data notification");
        return;
    }

    return;
}

// app/src/ppg.c
#include "ppg.h"
#include <zephyr/logging/log.h>

LOG_MODULE_REGISTER(ppg, CONFIG_PPG_LOG_LEVEL);

// Masseter-specific configuration constants
#define MASSETER_LED_RED_CURRENT    0x1F    // 6.2mA - lower for thin tissue
#define MASSETER_LED_IR_CURRENT     0x2F    // 9.4mA - better penetration
#define MASSETER_LED_GREEN_CURRENT  0x1F    // 6.2mA - surface monitoring
#define MASSETER_SAMPLE_RATE        25      // 25Hz optimal for jaw activity
#define MASSETER_FIFO_THRESHOLD     15      // Trigger at 15 samples (600ms)

int ppg_init(void)
{
    int err;
    
    LOG_INF("Initializing PPG sensor for masseter monitoring");
    
    // Initialize MAXM86161
    err = maxm86161_init();
    if (err) {
        LOG_ERR("MAXM86161 init failed: %d", err);
        return err;
    }
    
    // Configure LED currents for masseter (thin cheek tissue)
    // Lower power = better battery life
    err = maxm86161_write_reg(MAXM86161_REG_LED1_PA, MASSETER_LED_RED_CURRENT);
    if (err) {
        LOG_ERR("Failed to set RED LED current: %d", err);
        return err;
    }
    
    err = maxm86161_write_reg(MAXM86161_REG_LED2_PA, MASSETER_LED_IR_CURRENT);
    if (err) {
        LOG_ERR("Failed to set IR LED current: %d", err);
        return err;
    }
    
    err = maxm86161_write_reg(MAXM86161_REG_LED3_PA, MASSETER_LED_GREEN_CURRENT);
    if (err) {
        LOG_ERR("Failed to set GREEN LED current: %d", err);
        return err;
    }
    
    // Set sample rate to 25Hz (battery efficient)
    // Register value: 0x27 = 25Hz, 18-bit resolution
    err = maxm86161_write_reg(MAXM86161_REG_SPO2_CONFIG, 0x27);
    if (err) {
        LOG_ERR("Failed to set sample rate: %d", err);
        return err;
    }
    
    // Configure FIFO to minimize interrupts (battery saving)
    // Trigger when 15 samples are ready (600ms @ 25Hz)
    uint8_t fifo_threshold = 128 - (MASSETER_FIFO_THRESHOLD * 3);  // 3 channels
    err = maxm86161_write_reg(MAXM86161_REG_FIFO_CONFIG, fifo_threshold);
    if (err) {
        LOG_ERR("Failed to configure FIFO: %d", err);
        return err;
    }
    
    LOG_INF("PPG configured: 25Hz, LEDs optimized for masseter");
    LOG_INF("  RED: %d (6.2mA), IR: %d (9.4mA), GREEN: %d (6.2mA)",
            MASSETER_LED_RED_CURRENT, MASSETER_LED_IR_CURRENT, MASSETER_LED_GREEN_CURRENT);
    
    return 0;
}

// Keep all other existing ppg.c functions unchanged

int ppg_start(void)
{
    // Enable the interrupt
    int err = gpio_pin_interrupt_configure_dt(&ppg_int, GPIO_INT_EDGE_TO_ACTIVE);
    if (err)
    {
        LOG_ERR("Failed to configure PPG sensor int pin interrupt");
        return err;
    }

    // Start the PPG sensor
    err = ppg_sensor_start(&i2c);
    if (err)
    {
        LOG_ERR("Failed to start PPG sensor");
        return err;
    }

    return 0;
}

int ppg_stop(void)
{
    // Stop the PPG sensor
    int err = ppg_sensor_stop(&i2c);
    if (err)
    {
        LOG_ERR("Failed to stop PPG sensor");
        return err;
    }

    // Disable the interrupt
    err = gpio_pin_interrupt_configure_dt(&ppg_int, GPIO_INT_DISABLE);
    if (err)
    {
        LOG_ERR("Failed to disable PPG sensor int pin interrupt");
        return err;
    }

    return 0;
}

int ppg_read_reg(uint8_t reg)
{
    uint8_t data;
    int err = ppg_sensor_read_reg(&i2c, reg, &data);
    if (err)
    {
        LOG_ERR("Failed to read PPG sensor register 0x%02X", reg);
        return err;
    }

    return 0;
}

int ppg_write_reg(uint8_t reg, uint8_t data)
{
    int err = ppg_sensor_write_reg(&i2c, reg, data);
    if (err)
    {
        LOG_ERR("Failed to write PPG sensor register 0x%02X", reg);
        return err;
    }

    return 0;
}

static void ppg_reg_work_handler(struct k_work *work)
{
    int err;
    struct ppg_reg_work_t *ppg_reg_work = CONTAINER_OF(work, struct ppg_reg_work_t, reg_work);

    uint8_t final_reg_data;
    if (ppg_reg_work->read)
    {
        err = ppg_sensor_read_reg(&i2c, ppg_reg_work->reg, &final_reg_data);
        if (err)
        {
            LOG_ERR("Failed to read PPG sensor register 0x%02X", ppg_reg_work->reg);
            return;
        }

        err = tgm_service_send_read_ppg_reg_notify(final_reg_data);
    }
    else
    {
        err = ppg_sensor_write_reg(&i2c, ppg_reg_work->reg, ppg_reg_work->data);
        if (err)
        {
            LOG_ERR("Failed to write PPG sensor register 0x%02X", ppg_reg_work->reg);
            return;
        }
        err = ppg_sensor_read_reg(&i2c, ppg_reg_work->reg, &final_reg_data);
        if (err)
        {
            LOG_ERR("Failed to read PPG sensor register 0x%02X after writing", ppg_reg_work->reg);
            // Allow to continue since the write was successful
        }

        err = tgm_service_send_write_ppg_reg_notify(final_reg_data);
    }

    if (err)
    {
        LOG_ERR("Failed to send PPG register value notification");
        return;
    }

    return;
}

int ppg_set_led_pa(enum ppg_led_t led, uint8_t pa)
{
    int err;

    err = ppg_write_reg(MAXM86161_REG_LED1_PA + led, pa);
    if (err)
    {
        LOG_ERR("Failed to set PPG LED PA for LED %d", led);
    }

    return 0;
}
```
